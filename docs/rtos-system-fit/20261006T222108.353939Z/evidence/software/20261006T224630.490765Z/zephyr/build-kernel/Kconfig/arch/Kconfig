## docs/rtos-system-fit/20261006T222108.353939Z/evidence/software/20261006T224630.490765Z/zephyr/build-kernel/Kconfig/arch/Kconfig
```kconfig
# Load Zephyr Arch Kconfig descriptions.
osource "/home/user/git/fpga/sipeedtangprimer20k-riscv/.deps/rtos/zephyr/arch/rx/Kconfig"
osource "/home/user/git/fpga/sipeedtangprimer20k-riscv/.deps/rtos/zephyr/arch/x86/Kconfig"
osource "/home/user/git/fpga/sipeedtangprimer20k-riscv/.deps/rtos/zephyr/arch/xtensa/Kconfig"
osource "/home/user/git/fpga/sipeedtangprimer20k-riscv/.deps/rtos/zephyr/arch/sparc/Kconfig"
osource "/home/user/git/fpga/sipeedtangprimer20k-riscv/.deps/rtos/zephyr/arch/riscv/Kconfig"
osource "/home/user/git/fpga/sipeedtangprimer20k-riscv/.deps/rtos/zephyr/arch/posix/Kconfig"
osource "/home/user/git/fpga/sipeedtangprimer20k-riscv/.deps/rtos/zephyr/arch/openrisc/Kconfig"
osource "/home/user/git/fpga/sipeedtangprimer20k-riscv/.deps/rtos/zephyr/arch/mips/Kconfig"
osource "/home/user/git/fpga/sipeedtangprimer20k-riscv/.deps/rtos/zephyr/arch/arm64/Kconfig"
osource "/home/user/git/fpga/sipeedtangprimer20k-riscv/.deps/rtos/zephyr/arch/arm/Kconfig"
osource "/home/user/git/fpga/sipeedtangprimer20k-riscv/.deps/rtos/zephyr/arch/arc/Kconfig"
```

## docs/rtos-system-fit/20261006T222108.353939Z/evidence/software/20261006T224630.490765Z/zephyr/build-kernel/Kconfig/soc/Kconfig.tmp
```kconfig
# Load Zephyr SoC Kconfig descriptions.
osource "/home/user/git/fpga/sipeedtangprimer20k-riscv/.deps/rtos/zephyr/soc/xlnx/zynqmp/Kconfig"
osource "/home/user/git/fpga/sipeedtangprimer20k-riscv/.deps/rtos/zephyr/soc/xlnx/zynq7000/Kconfig"
osource "/home/user/git/fpga/sipeedtangprimer20k-riscv/.deps/rtos/zephyr/soc/xlnx/versalnet/Kconfig"
osource "/home/user/git/fpga/sipeedtangprimer20k-riscv/.deps/rtos/zephyr/soc/xlnx/versal2/Kconfig"
osource "/home/user/git/fpga/sipeedtangprimer20k-riscv/.deps/rtos/zephyr/soc/xlnx/versal/Kconfig"
osource "/home/user/git/fpga/sipeedtangprimer20k-riscv/.deps/rtos/zephyr/soc/xen/Kconfig"
osource "/home/user/git/fpga/sipeedtangprimer20k-riscv/.deps/rtos/zephyr/soc/wch/ch32v/Kconfig"
osource "/home/user/git/fpga/sipeedtangprimer20k-riscv/.deps/rtos/zephyr/soc/ti/simplelink/Kconfig"
osource "/home/user/git/fpga/sipeedtangprimer20k-riscv/.deps/rtos/zephyr/soc/ti/mspm0/Kconfig"
osource "/home/user/git/fpga/sipeedtangprimer20k-riscv/.deps/rtos/zephyr/soc/ti/lm3s6965/Kconfig"
osource "/home/user/git/fpga/sipeedtangprimer20k-riscv/.deps/rtos/zephyr/soc/ti/k3/Kconfig"
osource "/home/user/git/fpga/sipeedtangprimer20k-riscv/.deps/rtos/zephyr/soc/telink/tlsr/Kconfig"
osource "/home/user/git/fpga/sipeedtangprimer20k-riscv/.deps/rtos/zephyr/soc/syna/sr100/Kconfig"
osource "/home/user/git/fpga/sipeedtangprimer20k-riscv/.deps/rtos/zephyr/soc/starfive/jh71xx/Kconfig"
osource "/home/user/git/fpga/sipeedtangprimer20k-riscv/.deps/rtos/zephyr/soc/st/stm32/Kconfig"
osource "/home/user/git/fpga/sipeedtangprimer20k-riscv/.deps/rtos/zephyr/soc/snps/qemu_arc/Kconfig"
osource "/home/user/git/fpga/sipeedtangprimer20k-riscv/.deps/rtos/zephyr/soc/snps/nsim/arc_v/Kconfig"
osource "/home/user/git/fpga/sipeedtangprimer20k-riscv/.deps/rtos/zephyr/soc/snps/nsim/arc_classic/Kconfig"
osource "/home/user/git/fpga/sipeedtangprimer20k-riscv/.deps/rtos/zephyr/soc/snps/hsdk4xd/Kconfig"
osource "/home/user/git/fpga/sipeedtangprimer20k-riscv/.deps/rtos/zephyr/soc/snps/hsdk/Kconfig"
osource "/home/user/git/fpga/sipeedtangprimer20k-riscv/.deps/rtos/zephyr/soc/snps/emsk/Kconfig"
osource "/home/user/git/fpga/sipeedtangprimer20k-riscv/.deps/rtos/zephyr/soc/snps/emsdp/Kconfig"
osource "/home/user/git/fpga/sipeedtangprimer20k-riscv/.deps/rtos/zephyr/soc/snps/arc_iot/Kconfig"
osource "/home/user/git/fpga/sipeedtangprimer20k-riscv/.deps/rtos/zephyr/soc/silabs/Kconfig"
osource "/home/user/git/fpga/sipeedtangprimer20k-riscv/.deps/rtos/zephyr/soc/sifli/sf32/Kconfig"
osource "/home/user/git/fpga/sipeedtangprimer20k-riscv/.deps/rtos/zephyr/soc/sifive/sifive_freedom/Kconfig"
osource "/home/user/git/fpga/sipeedtangprimer20k-riscv/.deps/rtos/zephyr/soc/sensry/Kconfig"
osource "/home/user/git/fpga/sipeedtangprimer20k-riscv/.deps/rtos/zephyr/soc/rockchip/Kconfig"
osource "/home/user/git/fpga/sipeedtangprimer20k-riscv/.deps/rtos/zephyr/soc/renode/riscv_virtual/Kconfig"
osource "/home/user/git/fpga/sipeedtangprimer20k-riscv/.deps/rtos/zephyr/soc/renode/cortex_r8_virtual/Kconfig"
osource "/home/user/git/fpga/sipeedtangprimer20k-riscv/.deps/rtos/zephyr/soc/renesas/smartbond/Kconfig"
osource "/home/user/git/fpga/sipeedtangprimer20k-riscv/.deps/rtos/zephyr/soc/renesas/rz/Kconfig"
osource "/home/user/git/fpga/sipeedtangprimer20k-riscv/.deps/rtos/zephyr/soc/renesas/rx/Kconfig"
osource "/home/user/git/fpga/sipeedtangprimer20k-riscv/.deps/rtos/zephyr/soc/renesas/rcar/Kconfig"
osource "/home/user/git/fpga/sipeedtangprimer20k-riscv/.deps/rtos/zephyr/soc/renesas/ra/Kconfig"
osource "/home/user/git/fpga/sipeedtangprimer20k-riscv/.deps/rtos/zephyr/soc/realtek/fingerprint/Kconfig"
osource "/home/user/git/fpga/sipeedtangprimer20k-riscv/.deps/rtos/zephyr/soc/realtek/ec/Kconfig"
osource "/home/user/git/fpga/sipeedtangprimer20k-riscv/.deps/rtos/zephyr/soc/realtek/bee/Kconfig"
osource "/home/user/git/fpga/sipeedtangprimer20k-riscv/.deps/rtos/zephyr/soc/realtek/ameba/Kconfig"
osource "/home/user/git/fpga/sipeedtangprimer20k-riscv/.deps/rtos/zephyr/soc/raspberrypi/rpi_pico/Kconfig"
osource "/home/user/git/fpga/sipeedtangprimer20k-riscv/.deps/rtos/zephyr/soc/quicklogic/eos_s3/Kconfig"
osource "/home/user/git/fpga/sipeedtangprimer20k-riscv/.deps/rtos/zephyr/soc/qemu/virt_riscv/Kconfig"
osource "/home/user/git/fpga/sipeedtangprimer20k-riscv/.deps/rtos/zephyr/soc/qemu/or1k/Kconfig"
osource "/home/user/git/fpga/sipeedtangprimer20k-riscv/.deps/rtos/zephyr/soc/qemu/malta/Kconfig"
osource "/home/user/git/fpga/sipeedtangprimer20k-riscv/.deps/rtos/zephyr/soc/openisa/rv32m1/Kconfig"
osource "/home/user/git/fpga/sipeedtangprimer20k-riscv/.deps/rtos/zephyr/soc/openhwgroup/cva6/Kconfig"
osource "/home/user/git/fpga/sipeedtangprimer20k-riscv/.deps/rtos/zephyr/soc/oct/osd32mp15x/Kconfig"
osource "/home/user/git/fpga/sipeedtangprimer20k-riscv/.deps/rtos/zephyr/soc/nxp/s32/Kconfig"
osource "/home/user/git/fpga/sipeedtangprimer20k-riscv/.deps/rtos/zephyr/soc/nxp/rw/Kconfig"
osource "/home/user/git/fpga/sipeedtangprimer20k-riscv/.deps/rtos/zephyr/soc/nxp/mcx/Kconfig"
osource "/home/user/git/fpga/sipeedtangprimer20k-riscv/.deps/rtos/zephyr/soc/nxp/lpc/Kconfig"
osource "/home/user/git/fpga/sipeedtangprimer20k-riscv/.deps/rtos/zephyr/soc/nxp/layerscape/Kconfig"
osource "/home/user/git/fpga/sipeedtangprimer20k-riscv/.deps/rtos/zephyr/soc/nxp/kinetis/Kconfig"
osource "/home/user/git/fpga/sipeedtangprimer20k-riscv/.deps/rtos/zephyr/soc/nxp/imxrt/Kconfig"
osource "/home/user/git/fpga/sipeedtangprimer20k-riscv/.deps/rtos/zephyr/soc/nxp/imx/Kconfig"
osource "/home/user/git/fpga/sipeedtangprimer20k-riscv/.deps/rtos/zephyr/soc/nuvoton/numicro/Kconfig"
osource "/home/user/git/fpga/sipeedtangprimer20k-riscv/.deps/rtos/zephyr/soc/nuvoton/numaker/Kconfig"
osource "/home/user/git/fpga/sipeedtangprimer20k-riscv/.deps/rtos/zephyr/soc/nuvoton/npcx/Kconfig"
osource "/home/user/git/fpga/sipeedtangprimer20k-riscv/.deps/rtos/zephyr/soc/nuvoton/npcm/Kconfig"
osource "/home/user/git/fpga/sipeedtangprimer20k-riscv/.deps/rtos/zephyr/soc/nordic/Kconfig"
osource "/home/user/git/fpga/sipeedtangprimer20k-riscv/.deps/rtos/zephyr/soc/neorv32/Kconfig"
osource "/home/user/git/fpga/sipeedtangprimer20k-riscv/.deps/rtos/zephyr/soc/native/inf_clock/Kconfig"
osource "/home/user/git/fpga/sipeedtangprimer20k-riscv/.deps/rtos/zephyr/soc/microchip/sam/sama7/Kconfig"
osource "/home/user/git/fpga/sipeedtangprimer20k-riscv/.deps/rtos/zephyr/soc/microchip/sam/sam_d5x_e5x/Kconfig"
osource "/home/user/git/fpga/sipeedtangprimer20k-riscv/.deps/rtos/zephyr/soc/microchip/pic64/Kconfig"
osource "/home/user/git/fpga/sipeedtangprimer20k-riscv/.deps/rtos/zephyr/soc/microchip/pic32c/pic32cz_ca/Kconfig"
osource "/home/user/git/fpga/sipeedtangprimer20k-riscv/.deps/rtos/zephyr/soc/microchip/pic32c/pic32cx_sg/Kconfig"
osource "/home/user/git/fpga/sipeedtangprimer20k-riscv/.deps/rtos/zephyr/soc/microchip/pic32c/pic32cm_pl/Kconfig"
osource "/home/user/git/fpga/sipeedtangprimer20k-riscv/.deps/rtos/zephyr/soc/microchip/pic32c/pic32cm_jh/Kconfig"
osource "/home/user/git/fpga/sipeedtangprimer20k-riscv/.deps/rtos/zephyr/soc/microchip/miv/Kconfig"
osource "/home/user/git/fpga/sipeedtangprimer20k-riscv/.deps/rtos/zephyr/soc/microchip/mec/Kconfig"
osource "/home/user/git/fpga/sipeedtangprimer20k-riscv/.deps/rtos/zephyr/soc/mediatek/mt8xxx/Kconfig"
osource "/home/user/git/fpga/sipeedtangprimer20k-riscv/.deps/rtos/zephyr/soc/lowrisc/opentitan/Kconfig"
osource "/home/user/git/fpga/sipeedtangprimer20k-riscv/.deps/rtos/zephyr/soc/litex/litex_vexriscv/Kconfig"
osource "/home/user/git/fpga/sipeedtangprimer20k-riscv/.deps/rtos/zephyr/soc/ite/ec/Kconfig"
osource "/home/user/git/fpga/sipeedtangprimer20k-riscv/.deps/rtos/zephyr/soc/intel/wildcat_lake/Kconfig"
osource "/home/user/git/fpga/sipeedtangprimer20k-riscv/.deps/rtos/zephyr/soc/intel/raptor_lake/Kconfig"
osource "/home/user/git/fpga/sipeedtangprimer20k-riscv/.deps/rtos/zephyr/soc/intel/panther_lake/Kconfig"
osource "/home/user/git/fpga/sipeedtangprimer20k-riscv/.deps/rtos/zephyr/soc/intel/lakemont/Kconfig"
osource "/home/user/git/fpga/sipeedtangprimer20k-riscv/.deps/rtos/zephyr/soc/intel/intel_socfpga_std/Kconfig"
osource "/home/user/git/fpga/sipeedtangprimer20k-riscv/.deps/rtos/zephyr/soc/intel/intel_socfpga/Kconfig"
osource "/home/user/git/fpga/sipeedtangprimer20k-riscv/.deps/rtos/zephyr/soc/intel/intel_niosv/Kconfig"
osource "/home/user/git/fpga/sipeedtangprimer20k-riscv/.deps/rtos/zephyr/soc/intel/intel_ish/Kconfig"
osource "/home/user/git/fpga/sipeedtangprimer20k-riscv/.deps/rtos/zephyr/soc/intel/intel_adsp/Kconfig"
osource "/home/user/git/fpga/sipeedtangprimer20k-riscv/.deps/rtos/zephyr/soc/intel/elkhart_lake/Kconfig"
osource "/home/user/git/fpga/sipeedtangprimer20k-riscv/.deps/rtos/zephyr/soc/intel/atom/Kconfig"
osource "/home/user/git/fpga/sipeedtangprimer20k-riscv/.deps/rtos/zephyr/soc/intel/apollo_lake/Kconfig"
osource "/home/user/git/fpga/sipeedtangprimer20k-riscv/.deps/rtos/zephyr/soc/intel/alder_lake/Kconfig"
osource "/home/user/git/fpga/sipeedtangprimer20k-riscv/.deps/rtos/zephyr/soc/infineon/psoc4/Kconfig"
osource "/home/user/git/fpga/sipeedtangprimer20k-riscv/.deps/rtos/zephyr/soc/infineon/edge/Kconfig"
osource "/home/user/git/fpga/sipeedtangprimer20k-riscv/.deps/rtos/zephyr/soc/infineon/cat3/Kconfig"
osource "/home/user/git/fpga/sipeedtangprimer20k-riscv/.deps/rtos/zephyr/soc/infineon/cat1c/Kconfig"
osource "/home/user/git/fpga/sipeedtangprimer20k-riscv/.deps/rtos/zephyr/soc/infineon/cat1b/Kconfig"
osource "/home/user/git/fpga/sipeedtangprimer20k-riscv/.deps/rtos/zephyr/soc/infineon/cat1a/Kconfig"
osource "/home/user/git/fpga/sipeedtangprimer20k-riscv/.deps/rtos/zephyr/soc/gd/gd32/Kconfig"
osource "/home/user/git/fpga/sipeedtangprimer20k-riscv/.deps/rtos/zephyr/soc/gaisler/leon3/Kconfig"
osource "/home/user/git/fpga/sipeedtangprimer20k-riscv/.deps/rtos/zephyr/soc/gaisler/gr716a/Kconfig"
osource "/home/user/git/fpga/sipeedtangprimer20k-riscv/.deps/rtos/zephyr/soc/focaltech/Kconfig"
osource "/home/user/git/fpga/sipeedtangprimer20k-riscv/.deps/rtos/zephyr/soc/espressif/Kconfig"
osource "/home/user/git/fpga/sipeedtangprimer20k-riscv/.deps/rtos/zephyr/soc/ene/kb1200/Kconfig"
osource "/home/user/git/fpga/sipeedtangprimer20k-riscv/.deps/rtos/zephyr/soc/ene/kb106x/Kconfig"
osource "/home/user/git/fpga/sipeedtangprimer20k-riscv/.deps/rtos/zephyr/soc/elan/em32f967/Kconfig"
osource "/home/user/git/fpga/sipeedtangprimer20k-riscv/.deps/rtos/zephyr/soc/egis/Kconfig"
osource "/home/user/git/fpga/sipeedtangprimer20k-riscv/.deps/rtos/zephyr/soc/efinix/sapphire/Kconfig"
osource "/home/user/git/fpga/sipeedtangprimer20k-riscv/.deps/rtos/zephyr/soc/cdns/xtensa_sample_controller/Kconfig"
osource "/home/user/git/fpga/sipeedtangprimer20k-riscv/.deps/rtos/zephyr/soc/cdns/swerv/Kconfig"
osource "/home/user/git/fpga/sipeedtangprimer20k-riscv/.deps/rtos/zephyr/soc/cdns/sample_controller32/Kconfig"
osource "/home/user/git/fpga/sipeedtangprimer20k-riscv/.deps/rtos/zephyr/soc/cdns/dc233c/Kconfig"
osource "/home/user/git/fpga/sipeedtangprimer20k-riscv/.deps/rtos/zephyr/soc/brcm/bcmvk/Kconfig"
osource "/home/user/git/fpga/sipeedtangprimer20k-riscv/.deps/rtos/zephyr/soc/brcm/bcm2712/Kconfig"
osource "/home/user/git/fpga/sipeedtangprimer20k-riscv/.deps/rtos/zephyr/soc/brcm/bcm2711/Kconfig"
osource "/home/user/git/fpga/sipeedtangprimer20k-riscv/.deps/rtos/zephyr/soc/blackberry/qnxhv_vm/Kconfig"
osource "/home/user/git/fpga/sipeedtangprimer20k-riscv/.deps/rtos/zephyr/soc/bflb/Kconfig"
osource "/home/user/git/fpga/sipeedtangprimer20k-riscv/.deps/rtos/zephyr/soc/atmel/sam0/Kconfig"
osource "/home/user/git/fpga/sipeedtangprimer20k-riscv/.deps/rtos/zephyr/soc/atmel/sam/Kconfig"
osource "/home/user/git/fpga/sipeedtangprimer20k-riscv/.deps/rtos/zephyr/soc/aspeed/Kconfig"
osource "/home/user/git/fpga/sipeedtangprimer20k-riscv/.deps/rtos/zephyr/soc/arm/Kconfig"
osource "/home/user/git/fpga/sipeedtangprimer20k-riscv/.deps/rtos/zephyr/soc/arm/beetle/Kconfig"
osource "/home/user/git/fpga/sipeedtangprimer20k-riscv/.deps/rtos/zephyr/soc/antmicro/myra/Kconfig"
osource "/home/user/git/fpga/sipeedtangprimer20k-riscv/.deps/rtos/zephyr/soc/andestech/Kconfig"
osource "/home/user/git/fpga/sipeedtangprimer20k-riscv/.deps/rtos/zephyr/soc/amd/acp_6_0/Kconfig"
osource "/home/user/git/fpga/sipeedtangprimer20k-riscv/.deps/rtos/zephyr/soc/ambiq/Kconfig"
osource "/home/user/git/fpga/sipeedtangprimer20k-riscv/.deps/rtos/zephyr/soc/allwinner/sun8i_h3/Kconfig"
osource "/home/user/git/fpga/sipeedtangprimer20k-riscv/.deps/rtos/zephyr/soc/alif/ensemble/Kconfig"
osource "/home/user/git/fpga/sipeedtangprimer20k-riscv/.deps/rtos/zephyr/soc/aesc/Kconfig"
osource "/home/user/git/fpga/sipeedtangprimer20k-riscv/.deps/rtos/zephyr/soc/adi/max32/Kconfig"
```

## docs/rtos-system-fit/20261006T222108.353939Z/evidence/software/20261006T224829.566179Z/zephyr/build-kernel/Kconfig/boards/Kconfig.sysbuild.tmp
```kconfig
# Load Sysbuild board Kconfig descriptions.
osource "/home/user/git/fpga/sipeedtangprimer20k-riscv/.deps/rtos/zephyr/boards/enjoydigital/litex_vexriscv/Kconfig.sysbuild"
```

## docs/rtos-system-fit/20261006T222108.353939Z/evidence/software/20261006T224829.566179Z/zephyr/build-peripherals/Kconfig/boards/Kconfig.defconfig
```kconfig
# Load Zephyr board defconfig descriptions.
osource "/home/user/git/fpga/sipeedtangprimer20k-riscv/.deps/rtos/zephyr/boards/enjoydigital/litex_vexriscv/Kconfig.defconfig"
```
